/dts-v1/;
/plugin/;

/*
 * DT error test for the A5E message box / remoteproc probe (tools/dt_error_tests.sh).
 * Applied after cubie-a5e-flight-stack; replaces one property so that one probe
 * check fails. Test only: never in a normal boot.
 */

#include <dt-bindings/clock/sun55i-a523-ccu.h>
#include <dt-bindings/clock/sun55i-a523-mcu-ccu.h>
#include <dt-bindings/clock/sun55i-a523-r-ccu.h>
#include <dt-bindings/reset/sun55i-a523-ccu.h>
#include <dt-bindings/reset/sun55i-a523-mcu-ccu.h>
#include <dt-bindings/reset/sun55i-a523-r-ccu.h>

/* The test script reads this back to see that U-Boot applied the overlay */
&{/} {
	dt-error-test = "rproc-sram-outside-map";
};

/* sram-a3-0 runs 4 KiB past space 0: no single window of the address map holds it */
&rproc {
	reg = <0x07130000 0x1000>,
	      <0x07280000 0x41000>,
	      <0x072c0000 0x40000>,
	      <0x07010364 0x4>;
};
