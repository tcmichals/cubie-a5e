/dts-v1/;
/plugin/;

/*
 * DT error test for the A5E message box / remoteproc probe (tools/dt_error_tests.sh).
 * Applied after cubie-a5e-flight-stack; replaces one property so that one probe
 * check fails. Test only: never in a normal boot.
 */

#include <dt-bindings/clock/sun55i-a523-ccu.h>
#include <dt-bindings/clock/sun55i-a523-mcu-ccu.h>
#include <dt-bindings/clock/sun55i-a523-r-ccu.h>
#include <dt-bindings/reset/sun55i-a523-ccu.h>
#include <dt-bindings/reset/sun55i-a523-mcu-ccu.h>
#include <dt-bindings/reset/sun55i-a523-r-ccu.h>

/* The test script reads this back to see that U-Boot applied the overlay */
&{/} {
	dt-error-test = "rproc-bad-firmware-name";
};

/* Four bytes and no NUL: not a string */
&rproc {
	firmware-name = <0x41424344>;
};
