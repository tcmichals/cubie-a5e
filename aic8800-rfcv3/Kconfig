## aic8800-rfcv3/Kconfig
```kconfig
# SPDX-License-Identifier: GPL-2.0-only

config WLAN_VENDOR_AIC
	bool "AIC devices"
	default y
	help
	  Say Y to expose the AIC8800D80 U02 Wi-Fi driver, over SDIO or USB.
	  The first upstreaming target is a narrow D80 U02 SDIO station
	  configuration; legacy transport, Bluetooth, Android, test and
	  manufacturing build switches are intentionally not exposed.

if WLAN_VENDOR_AIC

choice
	prompt "AIC8800 bus"
	default AIC8800_SDIO_SUPPORT
	help
	  The driver is built for one bus. A kernel with both an SDIO and a
	  USB AIC8800 board needs the choice made per image.

config AIC8800_SDIO_SUPPORT
	bool "SDIO"
	depends on MMC

config AIC8800_USB_SUPPORT
	bool "USB"
	depends on USB
	help
	  The USB chip enumerates in its BootROM as a69c:8d80 and needs its
	  firmware loaded by the vendor aic_load_fw module (not part of this
	  driver) before it comes back as a69c:8d81 or a69c:8d83.

endchoice

menuconfig AIC8800_BSP_SUPPORT
	tristate "AIC8800D80 U02 SDIO bus support"
	depends on AIC8800_SDIO_SUPPORT
	help
	  Enable the AIC8800D80 U02 SDIO bus support package. It provides
	  the SDIO transport, chip operations and firmware download path used
	  by the AIC8800 FullMAC WLAN driver.

	  Firmware files are loaded from the aic8800/ subdirectory of the
	  kernel firmware search path, normally /lib/firmware/aic8800/.

	  If unsure, say N.

if AIC8800_BSP_SUPPORT

config AIC8800_SDIO_PWRCTRL
	def_bool y

source "drivers/net/wireless/aic/aic8800_bsp/Kconfig"

endif # AIC8800_BSP_SUPPORT

source "drivers/net/wireless/aic/aic8800_fdrv/Kconfig"

endif # WLAN_VENDOR_AIC
```

## aic8800-upstream/Kconfig
```kconfig
# SPDX-License-Identifier: GPL-2.0-only

config WLAN_VENDOR_AIC
	bool "AIC devices"
	default y
	help
	  Say Y to expose drivers for wireless devices based on AIC
	  chipsets. The individual bus and WLAN drivers remain separately
	  selectable below this vendor menu. Saying N hides those driver
	  questions without changing any unrelated wireless drivers.

if WLAN_VENDOR_AIC

menuconfig AIC8800_BSP_SUPPORT
	tristate "AIC8800 SDIO bus support"
	depends on MMC
	help
	  Enable the AIC8800 bus support package. It provides the SDIO
	  transport, chip operations and firmware download infrastructure
	  shared by the AIC8800 FullMAC WLAN driver.
	  Firmware files are loaded from the aic8800/ subdirectory of the
	  kernel firmware search path, normally /lib/firmware/aic8800/.

	  If unsure, say N.

if AIC8800_BSP_SUPPORT

# The current driver only implements an SDIO transport. Keep this internal
# symbol for the existing Makefile and C preprocessor conditionals.
config AIC8800_SDIO_SUPPORT
	def_bool y

menu "AIC8800 common firmware and transport options"

config AIC8800_SDIO_PWRCTRL
	bool "SDIO power control"
	default y
	help
	  Allow the driver to control the SDIO interface power state while
	  bringing the AIC device up and down. The BSP coordinates this
	  state with firmware download and the WLAN function. This is the
	  normal setting for supported AIC8800 SDIO modules.

	  If unsure, say Y.

config AIC8800_GPIO_WAKEUP
	bool "GPIO wakeup support"
	default y
	help
	  Enable a dedicated GPIO signal for device-to-host wakeup. The
	  signal lets the device wake the host without polling the SDIO
	  bus. Board wiring and firmware must both provide the wake signal.
	  Disable this when the board has no dedicated wake GPIO.

	  If unsure, say Y.

config AIC8800_OOB
	bool "Out-of-band interrupt support"
	depends on AIC8800_GPIO_WAKEUP
	help
	  Use a dedicated GPIO interrupt instead of the in-band SDIO
	  interrupt. The GPIO must be described by the platform and wired
	  to the AIC device interrupt output. This mode is only suitable
	  for boards whose firmware and hardware use out-of-band signaling.

config AIC8800_PREALLOC_TXQ
	bool "Preallocate TX queues"
	default y
	help
	  Preallocate transmit queue buffers during driver initialization.
	  This avoids data-path allocations after the interface starts and
	  can reduce latency under memory pressure. It also reserves the
	  queue memory for the lifetime of the driver.

	  If unsure, say Y.

config AIC8800_DPD
	bool "DPD calibration support"
	default y
	help
	  Enable Digital Pre-Distortion calibration support for radio
	  transmit-path linearization. The driver loads or generates DPD
	  data expected by supported firmware. Keep this enabled for boards
	  whose supplied firmware requires DPD calibration data.

	  If unsure, say Y.

config AIC8800_FORCE_DPD_CALIB
	bool "Force DPD calibration"
	depends on AIC8800_DPD
	default y
	help
	  Force DPD calibration instead of using existing calibration data.
	  This makes initialization regenerate the result even when stored
	  calibration data is available. It increases startup work but can
	  be useful while validating a new board or radio configuration.

config AIC8800_RESV_MEM_SUPPORT
	bool "Reserved memory support"
	default y
	help
	  Enable the driver's reserved-memory allocation path for transport
	  buffers. Platforms may use this to avoid allocating large buffers
	  during device initialization. The reserved area must be supplied
	  by the platform integration when this option is selected.

	  If unsure, say Y.

config AIC8800_SDIO_BT
	bool "Bluetooth over SDIO support"
	depends on BROKEN
	help
	  Enable the downstream Bluetooth transport sharing the Wi-Fi SDIO
	  interface. The retained implementation uses interfaces that are
	  not available to a current mainline kernel. It remains disabled
	  until it is converted to the upstream Bluetooth HCI interfaces.

config AIC8800_VRF_DCDC_MODE
	bool "VRF DCDC mode"
	default y
	help
	  Configure the chipset's VRF rail to use its internal DC-DC mode.
	  This affects radio power delivery and must agree with the module
	  and board power design. The standard supported configuration uses
	  the internal converter. Check the board design before changing it.

	  If unsure, say Y.

endmenu

source "drivers/net/wireless/aic/aic8800_bsp/Kconfig"
source "drivers/net/wireless/aic/aic8800_fdrv/Kconfig"

endif # AIC8800_BSP_SUPPORT
endif # WLAN_VENDOR_AIC
```

## aic8800-upstream/aic8800_bsp/Kconfig
```kconfig
# SPDX-License-Identifier: GPL-2.0-only

menu "AIC8800 BSP options"

config AIC8800_BSP_M2D_OTA_AUTO
	bool "M2D OTA auto support"
	default n
	help
	  Enable automatic M2D (Module-to-Device) over-the-air firmware
	  update support. When enabled, the driver will automatically
	  handle firmware download and update from the host to the device
	  over the SDIO interface.

	  If unsure, say N.

config AIC8800_BSP_M2D_OTA_LZMA
	bool "M2D OTA LZMA support"
	depends on AIC8800_BSP_M2D_OTA_AUTO
	default n
	help
	  Enable LZMA compression support for M2D over-the-air firmware
	  updates. This reduces the size of firmware images transferred
	  over the SDIO bus at the cost of additional CPU time for
	  decompression.

	  If unsure, say N.

config AIC8800_BSP_LINK_DET_5G
	bool "5G link detect"
	default y
	help
	  Enable 5 GHz band link detection support. When enabled, the
	  driver performs additional link quality monitoring on the 5 GHz
	  band to detect and recover from link degradation.

	  If unsure, say Y.

config AIC8800_BSP_AMSDU_RX
	bool "AMSDU receive"
	default n
	help
	  Enable A-MSDU (Aggregate MAC Service Data Unit) receive support
	  at the BSP layer. This allows the SDIO transport layer to handle
	  aggregated frames, improving receive throughput for large data
	  transfers.

	  If unsure, say N.

config AIC8800_BSP_IRQ_FALL
	bool "Falling edge IRQ"
	depends on AIC8800_GPIO_WAKEUP
	default n
	help
	  Use falling edge trigger for SDIO interrupts instead of the
	  default rising edge. Some platform designs require falling edge
	  IRQ configuration due to hardware signal inversion.

	  Only enable this if your hardware design requires it.

	  If unsure, say N.

config AIC8800_BSP_CUSTOM_PWF
	bool "Custom power waveform"
	depends on AIC8800_BSP_PLATFORM_EXTERNAL && BROKEN
	default n
	help
	  Enable custom power waveform configuration for the AIC8800
	  chipset. This allows fine-tuning of power delivery parameters
	  for specific hardware designs that require non-standard power
	  profiles.

	  If unsure, say N.

config AIC8800_BSP_TEDIOUS_PRT
	bool "Verbose print log"
	default n
	help
	  Enable verbose debug logging in the BSP layer. When enabled,
	  detailed SDIO bus transactions, firmware loading progress, and
	  chip operation traces are printed to the kernel log.

	  This is intended for development and debugging only.

	  If unsure, say N.

config AIC8800_BSP_PLATFORM_EXTERNAL
	bool "External platform"
	default n
	help
	  Enable support for external (non-integrated) platform
	  configurations. This option enables code paths required when
	  the AIC8800 chipset is used on a development board or external
	  adapter rather than an integrated system-on-module design.

	  If unsure, say N.

endmenu
```
