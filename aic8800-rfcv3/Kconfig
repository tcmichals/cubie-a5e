## project-cubie-a5e/Config.in
```kconfig
menu "Radxa Cubie A5E Flight Controller Custom Packages"
    source "$BR2_EXTERNAL_CUBIE_A5E_PATH/package/aic8800-driver/Config.in"
    source "$BR2_EXTERNAL_CUBIE_A5E_PATH/package/aic8800-firmware/Config.in"
    source "$BR2_EXTERNAL_CUBIE_A5E_PATH/package/timvx-delegate/Config.in"
    menu "Co-Processor Firmwares (RISC-V E907 & HiFi4 DSP)"
        source "$BR2_EXTERNAL_CUBIE_A5E_PATH/package/riscv-firmware/Config.in"
        source "$BR2_EXTERNAL_CUBIE_A5E_PATH/package/dsp-hifi4/Config.in"
    endmenu
    source "$BR2_EXTERNAL_CUBIE_A5E_PATH/package/boot0-a733/Config.in"
endmenu
```

## project-cubie-a5e/configs/cubie_a7a_defconfig
```kconfig
BR2_aarch64=y
BR2_cortex_a76_a55=y
BR2_TOOLCHAIN_BUILDROOT=y
BR2_TOOLCHAIN_BUILDROOT_GLIBC=y
BR2_KERNEL_HEADERS_7_1=y
BR2_GCC_VERSION_16_X=y
BR2_TOOLCHAIN_BUILDROOT_CXX=y
BR2_PACKAGE_HOST_GDB=y
BR2_GDB_VERSION_17=y
BR2_TARGET_GENERIC_HOSTNAME="cubie-a7a-flight"
BR2_TARGET_GENERIC_ISSUE="Welcome to Cubie A7A Flight Controller Distribution"
BR2_ROOTFS_DEVICE_CREATION_DYNAMIC_EUDEV=y
BR2_ROOTFS_OVERLAY="$(BR2_EXTERNAL_CUBIE_A5E_PATH)/board/radxa/cubie_a7a/rootfs-overlay"
BR2_ROOTFS_POST_BUILD_SCRIPT="$(BR2_EXTERNAL_CUBIE_A5E_PATH)/board/radxa/cubie_a7a/post-build.sh"
BR2_ROOTFS_POST_IMAGE_SCRIPT="$(BR2_EXTERNAL_CUBIE_A5E_PATH)/board/radxa/cubie_a7a/post-image.sh"
BR2_LINUX_KERNEL=y
BR2_LINUX_KERNEL_CUSTOM_GIT=y
BR2_LINUX_KERNEL_CUSTOM_REPO_URL="https://github.com/tcmichals/linux-cubie.git"
BR2_LINUX_KERNEL_CUSTOM_REPO_VERSION="a7a_remoteproc_camera_usb"
BR2_LINUX_KERNEL_USE_ARCH_DEFAULT_CONFIG=y
BR2_LINUX_KERNEL_CONFIG_FRAGMENT_FILES="$(BR2_EXTERNAL_CUBIE_A5E_PATH)/board/radxa/cubie_a7a/linux.config"
BR2_LINUX_KERNEL_DTS_SUPPORT=y
BR2_LINUX_KERNEL_INTREE_DTS_NAME="allwinner/sun60i-a733-cubie-a7a"
BR2_LINUX_KERNEL_CUSTOM_DTS_DIR="$(BR2_EXTERNAL_CUBIE_A5E_PATH)/dts-overlay"
BR2_LINUX_KERNEL_NEEDS_HOST_OPENSSL=y
BR2_PACKAGE_LINUX_TOOLS_GPIO=y
BR2_PACKAGE_GDB=y
BR2_PACKAGE_GDB_SERVER=y
BR2_PACKAGE_GDB_DEBUGGER=y
BR2_PACKAGE_MESA3D=y
BR2_PACKAGE_MESA3D_GALLIUM_DRIVER_ETNAVIV=y
BR2_PACKAGE_LINUX_FIRMWARE=y
BR2_PACKAGE_OPENOCD=y
BR2_PACKAGE_OPENOCD_SYSFS=y
BR2_PACKAGE_BUSYBOX_SHOW_OTHERS=y
BR2_PACKAGE_I2C_TOOLS=y
BR2_PACKAGE_SPI_TOOLS=y
BR2_PACKAGE_PYTHON3=y
BR2_PACKAGE_PYTHON3_SSL=y
BR2_PACKAGE_PYTHON_NUMPY=y
BR2_PACKAGE_PYTHON_PYTEST=y
BR2_PACKAGE_PYTHON_SERIAL_ASYNCIO=y
BR2_PACKAGE_PYTHON_SMBUS2=y
BR2_PACKAGE_PYTHON_SPIDEV=y
BR2_PACKAGE_PYTHON_GPIOD=y
BR2_PACKAGE_LIBGPIOD2=y
BR2_PACKAGE_LIBGPIOD2_TOOLS=y
BR2_PACKAGE_LIBV4L=y
BR2_PACKAGE_LIBV4L_UTILS=y
BR2_PACKAGE_LIBCAMERA_PIPELINE_SIMPLE=y
BR2_PACKAGE_LIBCAMERA_APPS=y
BR2_PACKAGE_BOOST_CONTRACT=y
BR2_PACKAGE_BOOST_COROUTINE=y
BR2_PACKAGE_BOOST_EXCEPTION=y
BR2_PACKAGE_BOOST_FIBER=y
BR2_PACKAGE_BOOST_GRAPH=y
BR2_PACKAGE_BOOST_GRAPH_PARALLEL=y
BR2_PACKAGE_BOOST_IOSTREAMS=y
BR2_PACKAGE_BOOST_JSON=y
BR2_PACKAGE_BOOST_LOCALE=y
BR2_PACKAGE_BOOST_LOG=y
BR2_PACKAGE_BOOST_MATH=y
BR2_PACKAGE_BOOST_MPI=y
BR2_PACKAGE_BOOST_NOWIDE=y
BR2_PACKAGE_BOOST_RANDOM=y
BR2_PACKAGE_BOOST_SERIALIZATION=y
BR2_PACKAGE_BOOST_STACKTRACE=y
BR2_PACKAGE_BOOST_SYSTEM=y
BR2_PACKAGE_BOOST_TEST=y
BR2_PACKAGE_BOOST_TYPE_ERASURE=y
BR2_PACKAGE_BOOST_URL=y
BR2_PACKAGE_BOOST_WAVE=y
BR2_PACKAGE_TENSORFLOW_LITE=y
BR2_PACKAGE_DROPBEAR=y
BR2_PACKAGE_ETHTOOL=y
BR2_PACKAGE_IW=y
BR2_PACKAGE_PHYTOOL=y
BR2_PACKAGE_WIRELESS_REGDB=y
BR2_PACKAGE_WIRELESS_TOOLS=y
BR2_PACKAGE_WPA_SUPPLICANT=y
BR2_PACKAGE_WPA_SUPPLICANT_CLI=y
BR2_PACKAGE_WPA_SUPPLICANT_PASSPHRASE=y
BR2_TARGET_ROOTFS_EXT2=y
BR2_TARGET_ROOTFS_EXT2_4=y
BR2_TARGET_ROOTFS_EXT2_SIZE="512M"
BR2_TARGET_ROOTFS_EXT2_MKFS_OPTIONS="-O ^64bit,^metadata_csum,^metadata_csum_seed,^orphan_file"
BR2_PACKAGE_HOST_DOSFSTOOLS=y
BR2_PACKAGE_HOST_GENIMAGE=y
BR2_PACKAGE_HOST_MTOOLS=y
BR2_PACKAGE_HOST_UBOOT_TOOLS=y
BR2_PACKAGE_AIC8800_DRIVER=y
# BR2_PACKAGE_AIC8800_DRIVER_SDIO is not set
BR2_PACKAGE_AIC8800_FIRMWARE=y
BR2_PACKAGE_RISCV_FIRMWARE=y
BR2_PACKAGE_RISCV_FIRMWARE_CORE_E902=y
```

## project-cubie-a5e/package/aic8800-driver/Config.in
```kconfig
config BR2_PACKAGE_AIC8800_DRIVER
	bool "aic8800-driver (upstream mainline)"
	depends on BR2_LINUX_KERNEL
	help
	  AIC8800 FullMAC Wi-Fi driver from upstream wireless-next.
	  Builds two modules: aic8800_bsp.ko (BSP/firmware) and
	  aic8800_fdrv.ko (cfg80211 WLAN).

if BR2_PACKAGE_AIC8800_DRIVER

config BR2_PACKAGE_AIC8800_DRIVER_SDIO
	bool "Enable SDIO bus transport (Cubie A5E)"
	default y
	help
	  Enable SDIO transport for AIC8800 on Cubie A5E. Without the
	  USB option this builds the RFC v3 tree (aic8800-rfcv3).

config BR2_PACKAGE_AIC8800_DRIVER_USB
	bool "Enable USB bus transport (Cubie A7A)"
	default y
	help
	  Enable USB transport for AIC8800 on Cubie A7A. This builds the
	  unified tree (aic8800-upstream): RFC v3 has no USB transport yet.

endif
```

## project-cubie-a5e/package/boot0-a733/Config.in
```kconfig
config BR2_PACKAGE_BOOT0_A733
	bool "boot0-a733"
	help
	  Allwinner A733 LPDDR5 DRAM initialization Boot0 firmware
	  for Radxa Cubie A7A.

	  https://github.com/radxa/allwinner-device
```

## project-cubie-a5e/package/dsp-hifi4/Config.in
```kconfig
config BR2_PACKAGE_DSP_HIFI4
	bool "dsp-hifi4 (Allwinner Cadence HiFi4 DSP)"
	help
	  Cadence Tensilica HiFi4 Audio DSP co-processor firmware.
	  Compiles the DSP firmware from local source directory using the
	  Xtensa HiFi4 GCC toolchain and installs binary payloads into
	  target `/lib/firmware/` and images directory.

if BR2_PACKAGE_DSP_HIFI4

choice
	prompt "Default Active Boot Firmware"
	default BR2_PACKAGE_DSP_HIFI4_APP_TESTMSGBOX
	help
	  Select which DSP firmware payload is installed as the default
	  `/lib/firmware/dsp-firmware.elf`.

config BR2_PACKAGE_DSP_HIFI4_APP_TESTMSGBOX
	bool "testMsgbox (Hardware Message Box & Trace0)"
	help
	  DSP application with hardware Message Box IPC and trace0 buffer.

config BR2_PACKAGE_DSP_HIFI4_APP_TESTBASIC
	bool "testBasic (Minimal DSP startup)"
	help
	  Minimal bare-metal DSP startup and resource table baseline.

endchoice

endif
```

## project-cubie-a5e/package/rbb-server/Config.in
```kconfig
config BR2_PACKAGE_RBB_SERVER
	bool "rbb-server"
	depends on BR2_aarch64
	help
	  On-Chip Direct MMIO Debug Access Daemon for XuanTie E907 RISC-V co-processor
	  debugging via ARM MMIO bridge.

	  Maps the RISC-V hardware debug module (DM) registers directly via /dev/mem
	  and connects OpenOCD to GDB over TCP.

	  No external JTAG probe required — the ARM Cortex-A55 accesses the
	  E907 debug module via the shared MCU AHB bus.

	  Run probe_riscv_debug.sh first to discover the debug module address,
	  then: rbb_server <address> &
	       openocd -f /etc/openocd/openocd_t527_local.cfg

	  See docs/buildroot/prompt5_riscv_debug_trace.md for full details.
```

## project-cubie-a5e/package/riscv-firmware/Config.in
```kconfig
config BR2_PACKAGE_RISCV_FIRMWARE
	bool "riscv-firmware (Allwinner XuanTie E906/E902 RISC-V)"
	help
	  XuanTie RISC-V co-processor bare-metal firmware.
	  Compiles the firmware from the local source directory and
	  installs binary payloads into target `/lib/firmware/` and
	  images directory.

if BR2_PACKAGE_RISCV_FIRMWARE

choice
	prompt "Target RISC-V Core"
	default BR2_PACKAGE_RISCV_FIRMWARE_CORE_E906
	help
	  Select the target RISC-V processor architecture.

config BR2_PACKAGE_RISCV_FIRMWARE_CORE_E906
	bool "XuanTie E906 (Allwinner T527 / A527 / Radxa Cubie A5E)"
	help
	  XuanTie E906 32-bit RISC-V core (RV32IMAFCX @ 200 MHz, 32 registers).

config BR2_PACKAGE_RISCV_FIRMWARE_CORE_E902
	bool "XuanTie E902 (Allwinner A733 / Radxa Cubie A7A)"
	help
	  XuanTie E902 32-bit RISC-V core (RV32EMC @ 200 MHz, 16 registers).

endchoice

choice
	prompt "Default Active Boot Firmware"
	default BR2_PACKAGE_RISCV_FIRMWARE_APP_TESTSTRINGBINARYTRACE0
	help
	  Select which RISC-V firmware payload is installed as the active
	  `/lib/firmware/riscv-firmware.elf` loaded by S60riscv at startup.

config BR2_PACKAGE_RISCV_FIRMWARE_APP_TESTSTRINGBINARYTRACE0
	bool "testStringBinaryTrace0 (Trace0 telemetry & RPMsg)"
	help
	  Telemetry firmware using circular trace0 buffer and fast SRAM ring.

config BR2_PACKAGE_RISCV_FIRMWARE_APP_TESTPINGRPMSG
	bool "testPingRpmsg (VirtIO RPMsg echo)"
	help
	  VirtIO RPMsg communication test firmware.

config BR2_PACKAGE_RISCV_FIRMWARE_APP_TESTMSGBOX
	bool "testMsgbox (Hardware Message Box & Trace0)"
	help
	  Hardware Message Box ping-pong test firmware with trace0 buffer.

config BR2_PACKAGE_RISCV_FIRMWARE_APP_EXAMPLERISCV
	bool "exampleRiscv (Minimal baseline)"
	help
	  Minimal bare-metal RISC-V startup and blink baseline.

endchoice

config BR2_PACKAGE_RISCV_FIRMWARE_HOST_TOOLS
	bool "Install host companion and benchmark tools"
	default y
	help
	  Install Linux host tools (ping_shm, ping_rpmsg, ping_dram, riscv-load,
	  load-riscv.sh, test_riscv.py, monitor_trace.py, fast_sram_telemetry.py)
	  to `/usr/bin`.

endif
```
