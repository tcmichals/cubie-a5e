## project-cubie-a5e/configs/cubie_a5e_defconfig
```kconfig
# Architecture Configuration
BR2_aarch64=y
BR2_cortex_a55=y

# Bleeding-Edge External Toolchain (Required for Linux 7.1 compliance)
BR2_TOOLCHAIN_EXTERNAL=y
BR2_TOOLCHAIN_EXTERNAL_BOOTLIN=y
BR2_TOOLCHAIN_EXTERNAL_BOOTLIN_AARCH64_GLIBC_BLEEDING_EDGE=y

# Target System Global Parameters
BR2_TARGET_GENERIC_HOSTNAME="cubie-a5e-flight"
BR2_TARGET_GENERIC_ISSUE="Welcome to Cubie A5E Flight Controller Distribution"
BR2_SYSTEM_DHCP="eth0"

# Target Device Management (Dynamic Rule Management Framework)
BR2_INIT_BUSYBOX=y
BR2_ROOTFS_DEVICE_CREATION_DYNAMIC_EUDEV=y
BR2_PACKAGE_EUDEV=y

# Out-of-Tree Workspace Directory Paths
BR2_ROOTFS_OVERLAY="$(BR2_EXTERNAL_CUBIE_A5E_PATH)/board/radxa/cubie_a5e/rootfs-overlay"
BR2_ROOTFS_POST_IMAGE_SCRIPT="$(BR2_EXTERNAL_CUBIE_A5E_PATH)/board/radxa/cubie_a5e/post-image.sh"

# Root Filesystem Allocation Formats (Required for genimage.cfg targets)
BR2_TARGET_ROOTFS_EXT2=y
BR2_TARGET_ROOTFS_EXT2_4=y
BR2_TARGET_ROOTFS_EXT2_SIZE="512M"

# Linux Kernel 7.1 Mainline Definitions
BR2_LINUX_KERNEL=y
BR2_LINUX_KERNEL_CUSTOM_VERSION=y
BR2_LINUX_KERNEL_CUSTOM_VERSION_VALUE="7.1"
BR2_LINUX_KERNEL_USE_CUSTOM_CONFIG=y
BR2_LINUX_KERNEL_CUSTOM_CONFIG_FILE="$(BR2_EXTERNAL_CUBIE_A5E_PATH)/board/radxa/cubie_a5e/linux.config"
BR2_LINUX_KERNEL_DTS_SUPPORT=y
BR2_LINUX_KERNEL_INTREE_DTS_NAME="allwinner/sun55i-a527-cubie-a5e"
BR2_LINUX_KERNEL_CUSTOM_DTS_DIR="$(BR2_EXTERNAL_CUBIE_A5E_PATH)/dts-overlay"
BR2_LINUX_KERNEL_DTB_OVERLAY_SUPPORT=y

# Native Linux Kernel Compiled Tools (GPIO User-space Utilities)
BR2_PACKAGE_LINUX_TOOLS_GPIO=y

# Peripheral bus/user-space validation tools
BR2_PACKAGE_LIBGPIOD=y
BR2_PACKAGE_LIBGPIOD_TOOLS=y
BR2_PACKAGE_I2C_TOOLS=y
BR2_PACKAGE_SPI_TOOLS=y

# Wireless Networking, Firmware, and Diagnostic Tools
BR2_PACKAGE_LINUX_FIRMWARE=y
BR2_PACKAGE_IW=y
BR2_PACKAGE_WIRELESS_TOOLS=y
BR2_PACKAGE_WPA_SUPPLICANT=y

# Multimedia Pipeline Framework Utilities
BR2_PACKAGE_LIBV4L=y
BR2_PACKAGE_V4L_UTILS=y

# Python 3 Core and Extension Runtime Libraries
BR2_PACKAGE_PYTHON3=y
BR2_PACKAGE_PYTHON3_SSL=y
BR2_PACKAGE_PYTHON3_ZLIB=y
BR2_PACKAGE_PYTHON_NUMPY=y
BR2_PACKAGE_PYTHON_SERIAL=y

# TinyML Hardware Acceleration Deployment Engines
BR2_PACKAGE_TENSORFLOW_LITE=y

# ARM Trusted Firmware (TF-A) - Corrected Jernejsk Source Build
BR2_TARGET_ARM_TRUSTED_FIRMWARE=y
BR2_TARGET_ARM_TRUSTED_FIRMWARE_CUSTOM_GIT=y
BR2_TARGET_ARM_TRUSTED_FIRMWARE_CUSTOM_REPO_URL="https://github.com/jernejsk/arm-trusted-firmware"
BR2_TARGET_ARM_TRUSTED_FIRMWARE_CUSTOM_REPO_VERSION="a523-v4"
BR2_TARGET_ARM_TRUSTED_FIRMWARE_PLATFORM="sun55i_a523"
BR2_TARGET_ARM_TRUSTED_FIRMWARE_BL31=y

# Mainline U-Boot v2026.01 Build & ATF Linking Environment Settings
BR2_TARGET_UBOOT=y
BR2_TARGET_UBOOT_BUILD_SYSTEM_KCONFIG=y
BR2_TARGET_UBOOT_CUSTOM_VERSION=y
BR2_TARGET_UBOOT_CUSTOM_VERSION_VALUE="2026.01"
BR2_TARGET_UBOOT_BOARD_DEFCONFIG="radxa-cubie-a5e"
BR2_TARGET_UBOOT_NEEDS_DTC=y
BR2_TARGET_UBOOT_NEEDS_PYLIBFDT=y
BR2_TARGET_UBOOT_NEEDS_OPENSSL=y
BR2_TARGET_UBOOT_NEEDS_ATF_BL31=y
BR2_TARGET_UBOOT_FORMAT_CUSTOM=y
BR2_TARGET_UBOOT_FORMAT_CUSTOM_NAME="u-boot-sunxi-with-spl.bin"
BR2_TARGET_UBOOT_CUSTOM_MAKEOPTS="HOSTCFLAGS='-I$(HOST_DIR)/include' HOSTLDFLAGS='-L$(HOST_DIR)/lib'"
BR2_TARGET_UBOOT_PATCH="$(BR2_EXTERNAL_CUBIE_A5E_PATH)/patches/uboot"
BR2_TARGET_UBOOT_CONFIG_FRAGMENT_FILES="$(BR2_EXTERNAL_CUBIE_A5E_PATH)/board/radxa/cubie_a5e/u-boot-fragment.config"

# Host Architecture Processing Tooling
BR2_PACKAGE_HOST_DOSFSTOOLS=y
BR2_PACKAGE_HOST_GENIMAGE=y
BR2_PACKAGE_HOST_MTOOLS=y
BR2_PACKAGE_HOST_GNUTLS=y

# Custom Out-of-Tree Workspace Application Packages
BR2_PACKAGE_AIC8800_DRIVER=y
BR2_PACKAGE_AIC8800_FIRMWARE=y
BR2_PACKAGE_SUNXI_GALCORE=y
BR2_PACKAGE_TIMVX_DELEGATE=y

BR2_TARGET_ROOTFS_EXT2_GEN=4
# host tooling additions
BR2_PACKAGE_HOST_UBOOT_TOOLS=y

# Remote Access and System Management Shells (Lightweight SSH)
BR2_PACKAGE_DROPBEAR=y
BR2_PACKAGE_DROPBEAR_CLIENT=y
```

## project-cubie-a5e/package/aic8800-radxa/Config.in
```kconfig
config BR2_PACKAGE_AIC8800_RADXA
	bool "aic8800-radxa"
	depends on BR2_LINUX_KERNEL
	help
	  Radxa's official AIC8800 WiFi/BT driver.
```

## project-cubie-a5e/package/sunxi-galcore/Config.in
```kconfig
config BR2_PACKAGE_SUNXI_GALCORE
	bool "sunxi-galcore"
	depends on BR2_LINUX_KERNEL
```

## project-cubie-a5e/package/timvx-delegate/Config.in
```kconfig
config BR2_PACKAGE_TIMVX_DELEGATE
	bool "timvx-delegate"
	depends on BR2_PACKAGE_TENSORFLOW_LITE
	help
	  Installs TIM-VX delegate runtime artifacts for Cubie A5E NPU validation.

if BR2_PACKAGE_TIMVX_DELEGATE

config BR2_PACKAGE_TIMVX_DELEGATE_PREBUILT_DIR
	string "Path to TIM-VX prebuilt runtime bundle"
	default ""
	help
	  Absolute path to a directory that contains TIM-VX runtime artifacts.
	  Expected layout (common):
	    <bundle>/lib/*.so*
	    <bundle>/bin/*    (optional)
	
	  During image build, libraries are copied into /usr/lib and binaries into
	  /usr/bin.

endif
```
