## project-cubie-a5e/Config.in
```kconfig
menu "Radxa Cubie A5E Flight Controller Custom Packages"
    source "$BR2_EXTERNAL_CUBIE_A5E_PATH/package/aic8800-driver/Config.in"
    source "$BR2_EXTERNAL_CUBIE_A5E_PATH/package/aic8800-firmware/Config.in"
    source "$BR2_EXTERNAL_CUBIE_A5E_PATH/package/timvx-delegate/Config.in"
    menu "Co-Processor Firmwares (RISC-V E906 & HiFi4 DSP)"
        source "$BR2_EXTERNAL_CUBIE_A5E_PATH/package/riscv-firmware/Config.in"
        source "$BR2_EXTERNAL_CUBIE_A5E_PATH/package/dsp-hifi4/Config.in"
    endmenu
    source "$BR2_EXTERNAL_CUBIE_A5E_PATH/package/boot0-a733/Config.in"
    config BR2_PACKAGE_LIBCAMERA_PIPELINE_SUN60I_ISP
        bool "libcamera sun60i-isp pipeline handler and IPA"
        depends on BR2_PACKAGE_LIBCAMERA
        help
          Enable the Allwinner A733 / T527 hardware ISP 602 (sun60i-isp)
          libcamera pipeline handler and IPA module.
endmenu
```
