/dts-v1/;
/plugin/;

/*
 * ============================================================================
 *      RADXA CUBIE A5E — CADENCE HIFI4 DSP MAILBOX ISOLATION TEST OVERLAY
 * ============================================================================
 * Configures the Linux 'mailbox-test' driver client to isolate and validate
 * hardware mailbox communication with the Cadence Tensilica HiFi4 Audio DSP.
 *
 * Mailbox Channels:
 *   - Channel 4: ARM Cortex-A55 -> HiFi4 DSP (Linux TX -> DSP RX)
 *   - Channel 5: HiFi4 DSP -> ARM Cortex-A55 (DSP TX -> Linux RX)
 *
 * Exposes debugfs interface:
 *   /sys/kernel/debug/mailbox-test-dsp/message
 *
 * Load in /boot/config.txt:
 *   dtoverlay=cubie-a5e-flight-stack cubie-a5e-dsp-mailbox-test
 * ============================================================================
 */

&{/} {
    mailbox_test_dsp: mailbox-test-dsp {
        compatible = "mailbox-test";
        mboxes = <&msgbox 4>, <&msgbox 5>;
        mbox-names = "tx", "rx";
        status = "okay";
    };
};

&msgbox {
    status = "okay";
};
