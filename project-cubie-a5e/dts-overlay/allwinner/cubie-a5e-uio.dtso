/dts-v1/;
/plugin/;

/*
 * ============================================================================
 *               RADXA CUBIE A5E — LITE-LIBMETAL UIO DOORBELL OVERLAY
 * ============================================================================
 * Converts the Allwinner T527 hardware message box into a generic Userspace
 * I/O (UIO) device using uio_pdrv_genirq.
 *
 * Memory Maps exposed under /sys/class/uio/uio0/maps/:
 *   map0: Allwinner MSGBOX MMIO @ 0x03003000 (4 KB) - For Host Doorbell TX
 *   map1: MCU Dedicated SRAM C  @ 0x07131000 (4 KB) - For Shared Ringbuffer / Ping
 *
 * Hardware IRQ:
 *   GIC SPI 0 (ARM message box bank; first entry inherited from &msgbox)
 * ============================================================================
 */

&msgbox {
    compatible = "generic-uio";
    reg = <0x03003000 0x1000>,
          <0x07131000 0x1000>;
    reg-names = "msgbox", "sram";
    status = "okay";
};

&rproc {
    /*
     * When UIO is active, RemoteProc runs in standalone lifecycle mode.
     * The mailbox is owned by uio_pdrv_genirq for userspace real-time IPC.
     */
    /delete-property/ mboxes;
    /delete-property/ mbox-names;
    status = "okay";
};
