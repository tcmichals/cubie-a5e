/dts-v1/;
/plugin/;

/*
 * ============================================================================
 *                 RADXA CUBIE A5E — TESTCRASH OVERLAY
 * ============================================================================
 * Hardware Overlay for testCrash firmware application:
 * RemoteProc exception trapping and post-mortem autopsy SRAM dump verification.
 *
 * In /boot/config.txt:
 *   dtoverlay=cubie-a5e-flight-stack cubie-a5e-testCrash
 * ============================================================================
 */

&rproc {
    status = "okay";
};
